/*
  GreenHouse_03_BME680_Relay_BME688_Fan_Pump
  Lesson 3: add a fan and pump.
  Manual hardware tests only. Instructions: README.md

  Author (concept and project direction): David Voss.
  Code and documentation generated by OpenAI Codex using GPT-6 Astra,
  following David Voss's requirements and instructions.
  An outcome of a 2026 Erasmus+ project between Berufskolleg Uerdingen,
  Krefeld, Germany, and Colegiul Tehnic "Costin D. Nenițescu" Pitești, Romania.
*/
#ifndef ENABLE_SECOND_TH
#define ENABLE_SECOND_TH 0  // Optional onboard BME688: change 0 to 1.
#endif
#include <Wire.h>
#include <Zanshin_BME680.h>
#if ENABLE_SECOND_TH
#include <Arduino_MKRIoTCarrier.h>
#endif
// Grove I2C Motor Driver v1.3 - required library version: 1.0.1
#include <Grove_I2C_Motor_Driver.h>

// Hardware and initial settings
const bool CLOUD_ENABLED = false; // Set to true after configuring your Thing.
const unsigned long SERIAL_BAUD = 9600;
const unsigned long SERIAL_WAIT_MS = 3000;
const unsigned long MEASUREMENT_INTERVAL_MS = 1000;
const uint32_t I2C_CLOCK_HZ = 100000;
const uint8_t BME_I2C_ADDRESS = 0x77; // Address solder pads: 0x76 or 0x77.
const uint8_t BME_OVERSAMPLING = Oversample1;
const float INVALID_MEASUREMENT = -999.0f;
// Wire uses fixed MKR pins D11/SDA and D12/SCL.
const uint8_t LIGHT_RELAY_PIN = 2; // Carrier Rev2 relay 2, COM/NO contacts.
const uint8_t RELAY_ON_LEVEL = HIGH;
const uint8_t RELAY_OFF_LEVEL = LOW;
const bool INITIAL_LIGHT_ON = false;
#if ENABLE_SECOND_TH
const uint8_t CARRIER_BME_I2C_ADDRESS = 0x76; // Fixed onboard BME688 address.
const unsigned long SECOND_TH_INTERVAL_MS = 3000;
const bool CARRIER_HAS_CASE = true;
#endif
const uint8_t MOTOR_I2C_ADDRESS = 0x0F;
const uint8_t PUMP_MOTOR_CHANNEL = MOTOR1;
const uint8_t FAN_MOTOR_CHANNEL = MOTOR2;
const int PUMP_ON_SPEED = 100; // Library 1.0.1: -100 ... 100 percent PWM duty cycle.
const int FAN_ON_SPEED = 100;
const int MOTOR_OFF_SPEED = 0;
static_assert(PUMP_ON_SPEED >= -100 && PUMP_ON_SPEED <= 100, "Pump speed must be -100 ... 100.");
static_assert(FAN_ON_SPEED >= -100 && FAN_ON_SPEED <= 100, "Fan speed must be -100 ... 100.");
const bool INITIAL_PUMP_ON = false;
const bool INITIAL_FAN_ON = false;

#include "thingProperties.h"

BME680_Class bme;
bool bmeReady = false;
bool cloudWasConnected = false;
unsigned long lastMeasurementMs = 0;
#if ENABLE_SECOND_TH
MKRIoTCarrier carrier;
#endif

#if ENABLE_SECOND_TH
bool secondReady = false;
unsigned long lastSecondTHMs = 0;
#endif
bool motorReady = false;

void setup() {
  digitalWrite(LIGHT_RELAY_PIN, RELAY_OFF_LEVEL);
  pinMode(LIGHT_RELAY_PIN, OUTPUT);
  Serial.begin(SERIAL_BAUD);
  const unsigned long start = millis();
  while (!Serial && millis() - start < SERIAL_WAIT_MS) { }
  Serial.println("\nLesson 3: manual hardware test");
  Wire.begin();
  Wire.setClock(I2C_CLOCK_HZ);
  temperature = INVALID_MEASUREMENT;
  humidity = INVALID_MEASUREMENT;

  motorReady = i2cPresent(MOTOR_I2C_ADDRESS);
  Serial.print("Motor driver @ 0x"); Serial.println(MOTOR_I2C_ADDRESS, HEX);
  if (motorReady) {
    Motor.begin(MOTOR_I2C_ADDRESS);
    Serial.begin(SERIAL_BAUD); // Motor.begin() sets 9600 baud.
    Motor.speed(PUMP_MOTOR_CHANNEL, MOTOR_OFF_SPEED);
    Motor.speed(FAN_MOTOR_CHANNEL, MOTOR_OFF_SPEED);
  } else {
    Serial.println("Motor driver: unavailable");
  }

#if ENABLE_SECOND_TH
  if (CARRIER_HAS_CASE) carrier.withCase();
  else carrier.noCase();
  Serial.println(carrier.begin() ? "Carrier: ready" : "Carrier: check module errors");
#endif

#if ENABLE_SECOND_TH
  temperature2 = INVALID_MEASUREMENT;
  humidity2 = INVALID_MEASUREMENT;
  secondReady = carrier.getBoardRevision() == BOARD_REVISION_2 &&
                i2cPresent(CARRIER_BME_I2C_ADDRESS) && carrier.Env.begin();
  Serial.println(secondReady ? "Second T/H sensor: ready" : "Second T/H sensor: unavailable");
#endif

  light = INITIAL_LIGHT_ON;
  applyLight(); // Apply after carrier.begin(), which also initializes relays.
  pump = INITIAL_PUMP_ON;
  fan = INITIAL_FAN_ON;
  applyPump();
  applyFan();
  Serial.println("Commands: l/L = light on/off, p/P = pump on/off, f/F = fan on/off, 0 = all off");

  Serial.print("External BME680 @ 0x"); Serial.println(BME_I2C_ADDRESS, HEX);
  // The Rev2 Carrier already occupies 0x76, even with optional readings disabled.
  if (BME_I2C_ADDRESS == 0x76) {
    Serial.println("BME address conflict: use 0x77 for the external sensor.");
  } else {
    bmeReady = bme.begin(I2C_CLOCK_HZ, BME_I2C_ADDRESS);
  }
  if (bmeReady) {
    bme.setOversampling(TemperatureSensor, BME_OVERSAMPLING);
    bme.setOversampling(HumiditySensor, BME_OVERSAMPLING);
    bme.setOversampling(PressureSensor, BME_OVERSAMPLING);
    bme.setGas(0, 0); // The BME gas heater is not needed in this lesson.
    bme.triggerMeasurement();
    Serial.println("External BME680: ready");
  } else {
    Serial.println("External BME680: unavailable; check wiring and address pads.");
  }

  Wire.setClock(I2C_CLOCK_HZ);
  if (CLOUD_ENABLED) {
    initProperties();
    ArduinoCloud.begin(ArduinoIoTPreferredConnection);
    setDebugMessageLevel(2);
    ArduinoCloud.printDebugInfo();
    Serial.println("Cloud: connecting; hardware tests continue.");
  } else {
    Serial.println("Cloud: disabled.");
  }
  lastMeasurementMs = millis();
}

void loop() {
  if (CLOUD_ENABLED) {
    ArduinoCloud.update();
    const bool connected = ArduinoCloud.connected();
    if (connected != cloudWasConnected) {
      Serial.println(connected ? "Cloud: connected" : "Cloud: disconnected");
      cloudWasConnected = connected;
    }
  }
  readSerialCommand();
  if (millis() - lastMeasurementMs >= MEASUREMENT_INTERVAL_MS) {
    lastMeasurementMs = millis();
    readSensors();
  }
}

void readSensors() {
  if (bmeReady && i2cPresent(BME_I2C_ADDRESS) && !bme.measuring()) {
    int32_t rawTemperature, rawHumidity, unusedPressure, unusedGas;
    // The library returns four values; this lesson uses temperature and humidity.
    bme.getSensorData(rawTemperature, rawHumidity, unusedPressure, unusedGas, false);
    temperature = rawTemperature / 100.0f;
    humidity = rawHumidity / 1000.0f;
    Serial.print("BME680: temperature = "); Serial.print(temperature);
    Serial.print(" C, humidity = "); Serial.print(humidity); Serial.println(" %");
  } else {
    temperature = INVALID_MEASUREMENT;
    humidity = INVALID_MEASUREMENT;
    Serial.println("BME680: no reading (unavailable or still measuring)");
  }

#if ENABLE_SECOND_TH
  readSecondTH();
#endif

  Serial.print("Requested states: light = "); Serial.print(light ? "ON" : "OFF");
  Serial.print(", pump = "); Serial.print(pump ? "ON" : "OFF");
  Serial.print(", fan = "); Serial.print(fan ? "ON" : "OFF");
  Serial.println();
}

bool i2cPresent(uint8_t address) {
  Wire.beginTransmission(address);
  return Wire.endTransmission() == 0;
}

#if ENABLE_SECOND_TH
void readSecondTH() {
  if (millis() - lastSecondTHMs < SECOND_TH_INTERVAL_MS) return;
  lastSecondTHMs = millis();
  if (secondReady && i2cPresent(CARRIER_BME_I2C_ADDRESS)) {
    // The Carrier library maintains its own measurement timing and cached values.
    temperature2 = carrier.Env.readTemperature();
    humidity2 = carrier.Env.readHumidity();
    Serial.print("Onboard BME688: temperature = "); Serial.print(temperature2);
    Serial.print(" C, humidity = "); Serial.print(humidity2); Serial.println(" %");
  } else {
    temperature2 = INVALID_MEASUREMENT;
    humidity2 = INVALID_MEASUREMENT;
    Serial.println("Second T/H sensor: no reading");
  }
}
#endif

void applyLight() {
  digitalWrite(LIGHT_RELAY_PIN, light ? RELAY_ON_LEVEL : RELAY_OFF_LEVEL);
  Serial.print("Light relay: command "); Serial.println(light ? "ON" : "OFF");
}

void applyPump() {
  if (motorReady && i2cPresent(MOTOR_I2C_ADDRESS)) {
    Motor.speed(PUMP_MOTOR_CHANNEL, pump ? PUMP_ON_SPEED : MOTOR_OFF_SPEED);
    Serial.print("Pump: command "); Serial.println(pump ? "ON" : "OFF");
  } else {
    Serial.println("Pump: command not sent, motor driver unavailable");
  }
}

void applyFan() {
  if (motorReady && i2cPresent(MOTOR_I2C_ADDRESS)) {
    Motor.speed(FAN_MOTOR_CHANNEL, fan ? FAN_ON_SPEED : MOTOR_OFF_SPEED);
    Serial.print("Fan: command "); Serial.println(fan ? "ON" : "OFF");
  } else {
    Serial.println("Fan: command not sent, motor driver unavailable");
  }
}

void readSerialCommand() {
  if (!Serial.available()) return;
  const char command = Serial.read();
  if (command == '\r' || command == '\n' || command == ' ') return;
  Serial.print("Serial command: "); Serial.println(command);
  switch (command) {
    case 'l': light = true; applyLight(); break;
    case 'L': light = false; applyLight(); break;
    case 'p': pump = true; applyPump(); break;
    case 'P': pump = false; applyPump(); break;
    case 'f': fan = true; applyFan(); break;
    case 'F': fan = false; applyFan(); break;
    case '0':
      light = false; applyLight();
      pump = false; applyPump();
      fan = false; applyFan();
      break;
    default: Serial.println("Unknown command."); break;
  }
}

void onLightChange() {
  Serial.println("Cloud: light changed");
  applyLight();
}

void onPumpChange() {
  Serial.println("Cloud: pump changed");
  applyPump();
}
void onFanChange() {
  Serial.println("Cloud: fan changed");
  applyFan();
}
