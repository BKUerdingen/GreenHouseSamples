/*
  GreenHouse_01_BME680_Temperature_Humidity
  Lesson 1: temperature and humidity.
  Manual hardware tests only. Instructions: README.md

  Author (concept and project direction): David Voss.
  Code and documentation generated by OpenAI Codex using GPT-6 Astra,
  following David Voss's requirements and instructions.
  An outcome of a 2026 Erasmus+ project between Berufskolleg Uerdingen,
  Krefeld, Germany, and Colegiul Tehnic "Costin D. Nenițescu" Pitești, Romania.
*/
#include <Wire.h>
#include <Zanshin_BME680.h>

// Hardware and initial settings
const bool CLOUD_ENABLED = false; // Set to true after configuring your Thing.
const unsigned long SERIAL_BAUD = 9600;
const unsigned long SERIAL_WAIT_MS = 3000;
const unsigned long MEASUREMENT_INTERVAL_MS = 1000;
const uint32_t I2C_CLOCK_HZ = 100000;
const uint8_t BME_I2C_ADDRESS = 0x77; // Address solder pads: 0x76 or 0x77.
const uint8_t BME_OVERSAMPLING = Oversample1;
const float INVALID_MEASUREMENT = -999.0f;
// Wire uses fixed MKR pins D11/SDA and D12/SCL.

#include "thingProperties.h"

BME680_Class bme;
bool bmeReady = false;
bool cloudWasConnected = false;
unsigned long lastMeasurementMs = 0;

void setup() {
  Serial.begin(SERIAL_BAUD);
  const unsigned long start = millis();
  while (!Serial && millis() - start < SERIAL_WAIT_MS) { }
  Serial.println("\nLesson 1: manual hardware test");
  Wire.begin();
  Wire.setClock(I2C_CLOCK_HZ);
  temperature = INVALID_MEASUREMENT;
  humidity = INVALID_MEASUREMENT;

  Serial.print("External BME680 @ 0x"); Serial.println(BME_I2C_ADDRESS, HEX);
  bmeReady = bme.begin(I2C_CLOCK_HZ, BME_I2C_ADDRESS);
  if (bmeReady) {
    bme.setOversampling(TemperatureSensor, BME_OVERSAMPLING);
    bme.setOversampling(HumiditySensor, BME_OVERSAMPLING);
    bme.setOversampling(PressureSensor, BME_OVERSAMPLING);
    bme.setGas(0, 0); // The BME gas heater is not needed in this lesson.
    bme.triggerMeasurement();
    Serial.println("External BME680: ready");
  } else {
    Serial.println("External BME680: unavailable; check wiring and address pads.");
  }

  Wire.setClock(I2C_CLOCK_HZ);
  if (CLOUD_ENABLED) {
    initProperties();
    ArduinoCloud.begin(ArduinoIoTPreferredConnection);
    setDebugMessageLevel(2);
    ArduinoCloud.printDebugInfo();
    Serial.println("Cloud: connecting; hardware tests continue.");
  } else {
    Serial.println("Cloud: disabled.");
  }
  lastMeasurementMs = millis();
}

void loop() {
  if (CLOUD_ENABLED) {
    ArduinoCloud.update();
    const bool connected = ArduinoCloud.connected();
    if (connected != cloudWasConnected) {
      Serial.println(connected ? "Cloud: connected" : "Cloud: disconnected");
      cloudWasConnected = connected;
    }
  }
  if (millis() - lastMeasurementMs >= MEASUREMENT_INTERVAL_MS) {
    lastMeasurementMs = millis();
    readSensors();
  }
}

void readSensors() {
  if (bmeReady && i2cPresent(BME_I2C_ADDRESS) && !bme.measuring()) {
    int32_t rawTemperature, rawHumidity, unusedPressure, unusedGas;
    // The library returns four values; this lesson uses temperature and humidity.
    bme.getSensorData(rawTemperature, rawHumidity, unusedPressure, unusedGas, false);
    temperature = rawTemperature / 100.0f;
    humidity = rawHumidity / 1000.0f;
    Serial.print("BME680: temperature = "); Serial.print(temperature);
    Serial.print(" C, humidity = "); Serial.print(humidity); Serial.println(" %");
  } else {
    temperature = INVALID_MEASUREMENT;
    humidity = INVALID_MEASUREMENT;
    Serial.println("BME680: no reading (unavailable or still measuring)");
  }
}

bool i2cPresent(uint8_t address) {
  Wire.beginTransmission(address);
  return Wire.endTransmission() == 0;
}
