/*
  GreenHouse_06_BME680_BME688_SGP30_Soil_Fan_Pump_Light_TFT_Touch - Read sensors and control actuators manually.
  Arduino MKR WiFi 1010 + MKR IoT Carrier Rev2 / Greenhouse Kit.
  No thresholds or automatic watering, ventilation, or lighting.
  Instructions, wiring, and Cloud setup: README.md

  Author (concept and project direction): David Voss.
  Code and documentation generated by OpenAI Codex using GPT-6 Astra,
  following David Voss's requirements and instructions.
  An outcome of a 2026 Erasmus+ project between Berufskolleg Uerdingen,
  Krefeld, Germany, and Colegiul Tehnic "Costin D. Nenițescu" Pitești, Romania.
*/
#ifndef ENABLE_SECOND_TH
#define ENABLE_SECOND_TH 1  // Onboard BME688: set to 0 to omit its readings.
#endif
#include <Wire.h>
#include <WiFiNINA.h>
#include <math.h>
#include <Arduino_MKRIoTCarrier.h>
// Grove I2C Motor Driver v1.3 - required library version: 1.0.1
#include <Grove_I2C_Motor_Driver.h>
#include <Zanshin_BME680.h>
#include <Adafruit_SGP30.h>

// ===================== Hardware test settings =====================
const bool CLOUD_ENABLED = true;       // Set to true only after configuring the Thing
const unsigned long SERIAL_BAUD = 9600;
const unsigned long SERIAL_WAIT_MS = 3000;
const unsigned long MEASUREMENT_INTERVAL_MS = 1000; // SGP30 requires approximately 1 Hz!
const uint32_t I2C_CLOCK_HZ = 100000;
const unsigned long LIGHT_READ_TIMEOUT_MS = 100; // Allow APDS9960 integration to finish

const uint8_t SOIL_PIN = A0;
const uint8_t LIGHT_RELAY_PIN = 2;       // Carrier Rev2: relay 2
const uint8_t RELAY_ON_LEVEL = HIGH;    // Swap levels if required by a different relay
const uint8_t RELAY_OFF_LEVEL = LOW;
const uint8_t SOIL_ADC_BITS = 10;        // Raw values 0 ... 1023; not a percentage

const uint8_t MOTOR_I2C_ADDRESS = 0x0F;  // Must match the address switch settings
const uint8_t BME_I2C_ADDRESS = 0x77;    // External: 0x76 OR 0x77; check the solder pads!
const uint8_t SGP30_I2C_ADDRESS = 0x58;  // Fixed; the library uses this address
const uint8_t LIGHT_I2C_ADDRESS = 0x39;  // Onboard APDS9960, fixed
const uint8_t CARRIER_BME_I2C_ADDRESS = 0x76; // Rev2: already used by the onboard sensor!
// Wire uses the fixed MKR pins SDA/D11 and SCL/D12 (I2C Grove connector).
// The two fixed sensor addresses are also used to check device presence.

const uint8_t PUMP_MOTOR_CHANNEL = MOTOR1;
const uint8_t FAN_MOTOR_CHANNEL = MOTOR2;
const int PUMP_ON_SPEED = 100;           // Library 1.0.1: -100 ... 100 percent PWM duty cycle
const int FAN_ON_SPEED = 100;
const int MOTOR_OFF_SPEED = 0;
static_assert(PUMP_ON_SPEED >= -100 && PUMP_ON_SPEED <= 100, "Pump speed must be -100 ... 100.");
static_assert(FAN_ON_SPEED >= -100 && FAN_ON_SPEED <= 100, "Fan speed must be -100 ... 100.");

const bool INITIAL_PUMP_ON = false;
const bool INITIAL_FAN_ON = false;
const bool INITIAL_LIGHT_ON = false;
const float INVALID_MEASUREMENT = -999.0f; // No BME reading yet, or BME unavailable
const bool CARRIER_HAS_CASE = true;
const unsigned long SECOND_TH_INTERVAL_MS = 3000;
const int INVALID_RAW_READING = -1;
const uint8_t BME_OVERSAMPLING = Oversample16;
const uint8_t BME_FILTER = IIR4;
const uint16_t BME_HEATER_C = 320;
const uint16_t BME_HEATER_MS = 150;


// Display and touch controls. The Carrier has TOUCH0 ... TOUCH4, no TOUCH5.
const touchButtons FAN_TOUCH = TOUCH0;
const touchButtons PUMP_TOUCH = TOUCH1;
const touchButtons LIGHT_TOUCH = TOUCH2;
const touchButtons PAGE_UP_TOUCH = TOUCH3;   // Previous page
const touchButtons PAGE_DOWN_TOUCH = TOUCH4; // Next page
const uint8_t PAGE_COUNT = 12;
const uint8_t INITIAL_PAGE = 0;
const uint8_t DISPLAY_ROTATION = 2;
const uint16_t DISPLAY_WIDTH = 240;
const uint16_t DISPLAY_HEIGHT = 240;
const uint32_t DISPLAY_SPI_HZ = 4000000; // Conservative clock for display transfers
const bool DISPLAY_STARTUP_TEST = false; // Four colors, then return to the selected page
const unsigned long DISPLAY_TEST_COLOR_MS = 750;
const uint8_t DISPLAY_TEST_COLOR_COUNT = 4;
const uint8_t DISPLAY_BACKLIGHT_ON_LEVEL = HIGH;
const uint8_t DISPLAY_CS_PIN = mkr_iot_carrier_rev2::TFT_CS;
const uint8_t DISPLAY_DC_PIN = mkr_iot_carrier_rev2::TFT_DC;
const uint8_t DISPLAY_BACKLIGHT_PIN = TFT_BACKLIGHT; // Rev2 D3, managed by Carrier
const uint8_t DISPLAY_TEXT_SIZE = 2;
const uint8_t DISPLAY_CHAR_WIDTH = 6 * DISPLAY_TEXT_SIZE;
const uint8_t DISPLAY_COLUMNS = 16;
const uint8_t DISPLAY_ROWS = 7;
const uint8_t DISPLAY_X = 24;
const uint8_t DISPLAY_Y = 48;
const uint8_t DISPLAY_LINE_HEIGHT = 20;
const unsigned long DISPLAY_REFRESH_MS = 500;
const uint16_t DISPLAY_BACKGROUND = ST77XX_BLACK;
const uint16_t DISPLAY_FOREGROUND = ST77XX_WHITE;
const uint16_t DISPLAY_ACCENT = ST77XX_CYAN;
static_assert(INITIAL_PAGE < PAGE_COUNT, "Initial page is out of range.");

#include "thingProperties.h"

MKRIoTCarrier carrier;
BME680_Class bme;
Adafruit_SGP30 sgp;
bool motorReady = false;
bool bmeReady = false;
bool sgpReady = false;
bool lightReady = false;
bool cloudWasConnected = false;
unsigned long lastMeasurementMs = 0;

// Cache values already acquired by readSensors(); display code never reads sensors.
int lightRed = INVALID_RAW_READING;
int lightGreen = INVALID_RAW_READING;
int lightBlue = INVALID_RAW_READING;
uint8_t bmeGasStatus = 0;
bool bmeGasStatusAvailable = false;
uint8_t currentPage = INITIAL_PAGE;
bool displayDirty = true;
bool displayPageChanged = true;
bool displayTestActive = false;
unsigned long displayTestStartMs = 0;
int displayTestPreviousColor = -1;
unsigned long lastDisplayMs = 0;
int lastWifiStatus = -100;
String observedThingId;
String observedDeviceId;
char previousLines[DISPLAY_ROWS][DISPLAY_COLUMNS + 1] = {};
uint8_t displayRow = 0;
const char* const PAGE_TITLES[PAGE_COUNT] = {
  "Overview", "BME680 T/H", "BME680 P/G", "BME688 T/H",
  "SGP30", "Soil", "Light", "Light / RGB",
  "Cloud", "Wi-Fi", "Thing ID", "Device ID"
};


#if ENABLE_SECOND_TH
bool secondReady = false;
unsigned long lastSecondTHMs = 0;
#endif


void setup() {
  // Turn the relay off first; apply the initial state after carrier.begin().
  digitalWrite(LIGHT_RELAY_PIN, RELAY_OFF_LEVEL);
  pinMode(LIGHT_RELAY_PIN, OUTPUT);
  Serial.begin(SERIAL_BAUD);
  const unsigned long serialStart = millis();
  while (!Serial && millis() - serialStart < SERIAL_WAIT_MS) { }
  Serial.println("\nGreenHouse_06_BME680_BME688_SGP30_Soil_Fan_Pump_Light_TFT_Touch: manual hardware test");

  Wire.begin();
  Wire.setClock(I2C_CLOCK_HZ);
  pinMode(SOIL_PIN, INPUT);
  analogReadResolution(SOIL_ADC_BITS);

  // Initialize actuators independently of the sensors and Cloud.
  motorReady = i2cPresent(MOTOR_I2C_ADDRESS);
  if (motorReady) {
    Motor.begin(MOTOR_I2C_ADDRESS);
    Serial.begin(SERIAL_BAUD); // Motor.begin() sets the baud rate to 9600.
    Motor.speed(PUMP_MOTOR_CHANNEL, MOTOR_OFF_SPEED);
    Motor.speed(FAN_MOTOR_CHANNEL, MOTOR_OFF_SPEED);
  }
  printDevice("Motor driver", MOTOR_I2C_ADDRESS, motorReady);

  if (CARRIER_HAS_CASE) carrier.withCase();
  else carrier.noCase();
  Serial.println(carrier.begin() ? "Carrier: OK" : "Carrier: at least one module is unavailable");
  // begin() initializes the screen and buttons before checking all sensors.
  // Ensure the Rev2 backlight is on even if begin() reports a sensor failure.
  if (carrier.getBoardRevision() == BOARD_REVISION_2) {
    pinMode(DISPLAY_BACKLIGHT_PIN, OUTPUT);
    digitalWrite(DISPLAY_BACKLIGHT_PIN, DISPLAY_BACKLIGHT_ON_LEVEL);
  }
  carrier.display.setRotation(DISPLAY_ROTATION);
  carrier.display.setTextWrap(false);
  // Test the light sensor even if another Carrier module fails.
  lightReady = i2cPresent(LIGHT_I2C_ADDRESS) && carrier.Light.begin();
  printDevice("Light sensor", LIGHT_I2C_ADDRESS, lightReady);

#if ENABLE_SECOND_TH
  temperature2 = INVALID_MEASUREMENT;
  humidity2 = INVALID_MEASUREMENT;
  secondReady = carrier.getBoardRevision() == BOARD_REVISION_2 &&
                i2cPresent(CARRIER_BME_I2C_ADDRESS) && carrier.Env.begin();
  Serial.println(secondReady ? "Second T/H sensor: ready" : "Second T/H sensor: unavailable");
#endif


  pump = INITIAL_PUMP_ON;
  fan = INITIAL_FAN_ON;
  light = INITIAL_LIGHT_ON;
  temperature = INVALID_MEASUREMENT;
  humidity = INVALID_MEASUREMENT;
  lightLevel = INVALID_RAW_READING;
  soilRaw = INVALID_RAW_READING;
  eCO2 = INVALID_RAW_READING;
  tvoc = INVALID_RAW_READING;
  pressure = INVALID_MEASUREMENT;
  gasResistance = INVALID_MEASUREMENT;
  Serial.println("Initial states:");
  applyPump();
  applyFan();
  applyLight();

  // Rev2 already uses 0x76 internally. Do not attach a second driver to it.
  if (carrier.getBoardRevision() == BOARD_REVISION_2 &&
      BME_I2C_ADDRESS == CARRIER_BME_I2C_ADDRESS) {
    Serial.println("BME: address conflict! Set the external sensor solder pads to 0x77 and update the constant.");
  } else {
    bmeReady = bme.begin(I2C_CLOCK_HZ, BME_I2C_ADDRESS);
  }
  printDevice("External BME680", BME_I2C_ADDRESS, bmeReady);
  if (bmeReady) {
    bme.setOversampling(TemperatureSensor, BME_OVERSAMPLING);
    bme.setOversampling(HumiditySensor, BME_OVERSAMPLING);
    bme.setOversampling(PressureSensor, BME_OVERSAMPLING);
    bme.setIIRFilter(BME_FILTER);
    bme.setGas(BME_HEATER_C, BME_HEATER_MS);
    bme.triggerMeasurement();
  }

  sgpReady = i2cPresent(SGP30_I2C_ADDRESS) && sgp.begin(); // Includes IAQinit()
  printDevice("SGP30", SGP30_I2C_ADDRESS, sgpReady);
  if (sgpReady) Serial.println("SGP30: the first ~15 s return warm-up values (400 ppm / 0 ppb).");
  Wire.setClock(I2C_CLOCK_HZ); // Some begin() functions reconfigure Wire.
  scanI2c();
  printHelp();

  if (CLOUD_ENABLED) {
    initProperties();
    ArduinoCloud.begin(ArduinoIoTPreferredConnection);
    Wire.setClock(I2C_CLOCK_HZ); // ECCX08 Cloud authentication can leave Wire at 1 MHz.
    setDebugMessageLevel(2);
    ArduinoCloud.printDebugInfo();
    Serial.println("Cloud: connecting; hardware testing continues.");
  } else {
    Serial.println("Cloud: disabled. Use the Serial Monitor to control the hardware.");
  }
  // Reinitialize after Carrier, SD, sensors and Cloud setup have finished.
  initializeDisplay();
  if (DISPLAY_STARTUP_TEST) startDisplayTest();
  lastMeasurementMs = millis();
  Serial.println("Touch: 00 fan, 01 pump, 02 light, 03 previous page, 04 next page");
  announcePage();
  updateDisplay();
}

void loop() {
  if (CLOUD_ENABLED) {
    ArduinoCloud.update();
    Wire.setClock(I2C_CLOCK_HZ); // Restore sensor bus speed after Cloud/ECCX08 access.
    const bool connected = ArduinoCloud.connected();
    if (connected != cloudWasConnected) {
      Serial.println(connected ? "Cloud: connected" : "Cloud: disconnected");
      cloudWasConnected = connected;
    }
  }
  readTouchButtons();
  readSerialCommand();

  // Measurement timing only; no automatic actuator decisions.
  const unsigned long now = millis();
  if (now - lastMeasurementMs >= MEASUREMENT_INTERVAL_MS) {
    lastMeasurementMs = now;
    readSensors();
    printActuators();
    displayDirty = true;
  }
  updateDisplay();
}

void readSensors() {
  Serial.println("--- Sensors ---");
#if ENABLE_SECOND_TH
  readSecondTH();
#endif
  printSecondTH(); // Always reserve one row, including between sensor updates.
  // Read the SGP30 regularly, once per second.
  if (sgpReady && sgp.IAQmeasure()) {
    eCO2 = sgp.eCO2;
    tvoc = sgp.TVOC;
    Serial.print("SGP30: eCO2 = "); Serial.print(sgp.eCO2);
    Serial.print(" ppm, TVOC = "); Serial.print(sgp.TVOC); Serial.println(" ppb");
  } else {
    eCO2 = INVALID_RAW_READING;
    tvoc = INVALID_RAW_READING;
    Serial.println("SGP30: eCO2 = -- ppm, TVOC = -- ppb");
  }

  if (bmeReady && i2cPresent(BME_I2C_ADDRESS) && !bme.measuring()) {
    int32_t rawTemperature, rawHumidity, pressurePa, gasOhm;
    // false: do not wait for a measurement. This call starts the next one.
    const uint8_t gasStatus = bme.getSensorData(rawTemperature, rawHumidity,
                                               pressurePa, gasOhm, false);
    bmeGasStatus = gasStatus;
    bmeGasStatusAvailable = true;
    temperature = rawTemperature / 100.0f;
    humidity = rawHumidity / 1000.0f;
    pressure = pressurePa / 100.0f;
    gasResistance = gasOhm;
    Serial.print("BME680: temperature = "); Serial.print(temperature);
    Serial.print(" C, humidity = "); Serial.print(humidity);
    Serial.println(" %");
    Serial.print("BME680: pressure = "); Serial.print(pressure);
    Serial.print(" hPa, gas = "); Serial.print(gasOhm); Serial.println(" Ohm");
    Serial.print("BME680: gas status = 0x"); Serial.println(gasStatus, HEX);
  } else {
    temperature = INVALID_MEASUREMENT;
    humidity = INVALID_MEASUREMENT;
    pressure = INVALID_MEASUREMENT;
    gasResistance = INVALID_MEASUREMENT;
    bmeGasStatusAvailable = false;
    Serial.println("BME680: temperature = -- C, humidity = -- %");
    Serial.println("BME680: pressure = -- hPa, gas = -- Ohm");
    Serial.println("BME680: gas status = -- (no reading)");
  }

  soilRaw = analogRead(SOIL_PIN);
  Serial.print("Soil moisture: raw ADC value = "); Serial.println(soilRaw);
  readLightSensor();
}

// APDS9960 colorAvailable() starts a conversion; readColor() stops it again.
// Wait briefly for a fresh reading instead of treating "still measuring" as failure.
void readLightSensor() {
  int red, green, blue, clear;
  bool readOk = false;
  const char* error = "sensor unavailable at 0x39";
  if (lightReady && i2cPresent(LIGHT_I2C_ADDRESS)) {
    error = "measurement timeout";
    const unsigned long startedMs = millis();
    do {
      if (carrier.Light.colorAvailable()) {
        readOk = carrier.Light.readColor(red, green, blue, clear);
        error = "I2C read failed";
        break;
      }
      delay(1);
    } while (millis() - startedMs < LIGHT_READ_TIMEOUT_MS);
  }
  if (readOk) {
    lightLevel = clear;
    lightRed = red; lightGreen = green; lightBlue = blue;
    Serial.print("Light: R = "); Serial.print(red);
    Serial.print(", G = "); Serial.print(green);
    Serial.print(", B = "); Serial.print(blue);
    Serial.print(", clear = "); Serial.println(clear);
  } else {
    lightLevel = INVALID_RAW_READING;
    lightRed = lightGreen = lightBlue = INVALID_RAW_READING;
    Serial.print("Light: R/G/B/clear = --; "); Serial.println(error);
  }
}

// These three functions demonstrate the actual actuator commands.
void applyPump() {
  displayDirty = true;
  if (motorReady && i2cPresent(MOTOR_I2C_ADDRESS)) {
    Motor.speed(PUMP_MOTOR_CHANNEL, pump ? PUMP_ON_SPEED : MOTOR_OFF_SPEED);
    Serial.print("Pump: command "); Serial.println(pump ? "ON" : "OFF");
  } else {
    Serial.println("Pump: command not sent, motor driver unavailable");
  }
}

void applyFan() {
  displayDirty = true;
  if (motorReady && i2cPresent(MOTOR_I2C_ADDRESS)) {
    Motor.speed(FAN_MOTOR_CHANNEL, fan ? FAN_ON_SPEED : MOTOR_OFF_SPEED);
    Serial.print("Fan: command "); Serial.println(fan ? "ON" : "OFF");
  } else {
    Serial.println("Fan: command not sent, motor driver unavailable");
  }
}

void applyLight() {
  displayDirty = true;
  digitalWrite(LIGHT_RELAY_PIN, light ? RELAY_ON_LEVEL : RELAY_OFF_LEVEL);
  Serial.print("Light relay: command "); Serial.println(light ? "ON" : "OFF");
}

void printActuators() {
  // Requested states: the actuators provide no feedback about actual operation.
  Serial.print("Actuators (requested): pump = "); Serial.print(pump ? "ON" : "OFF");
  Serial.print(", fan = "); Serial.print(fan ? "ON" : "OFF");
  Serial.print(", light = "); Serial.println(light ? "ON" : "OFF");
}

void printHelp() {
  Serial.println("Commands: p/P = pump on/off, f/F = fan on/off, l/L = light on/off");
  Serial.println("         0 = all off, s = requested states, i = I2C scan, ? = help");
  Serial.println("         [ = previous page, ] = next page, d = display test");
}

void readSerialCommand() {
  if (!Serial.available()) return;
  const char command = Serial.read();
  if (command == '\r' || command == '\n' || command == ' ') return;
  Serial.print("Serial command: "); Serial.println(command);
  switch (command) {
    case 'p': pump = true;  applyPump();  break;
    case 'P': pump = false; applyPump();  break;
    case 'f': fan = true;   applyFan();   break;
    case 'F': fan = false;  applyFan();   break;
    case 'l': light = true;  applyLight(); break;
    case 'L': light = false; applyLight(); break;
    case '0':
      pump = false; fan = false; light = false;
      applyPump(); applyFan(); applyLight();
      break;
    case 'd': initializeDisplay(); startDisplayTest(); break;
    case '[': changePage(-1); break;
    case ']': changePage(1); break;
    case 's': printActuators(); break;
    case 'i': scanI2c(); break;
    case '?': printHelp(); break;
    default: Serial.println("Unknown command. Enter ? for help."); break;
  }
}

bool i2cPresent(uint8_t address) {
  // Also protects motor commands called from inside ArduinoCloud.update().
  Wire.setClock(I2C_CLOCK_HZ);
  Wire.beginTransmission(address);
  return Wire.endTransmission() == 0;
}

void printDevice(const char* name, uint8_t address, bool ready) {
  Serial.print(name); Serial.print(" @ 0x"); Serial.print(address, HEX);
  Serial.println(ready ? ": OK" : ": not ready (check address/wiring)");
}

void scanI2c() {
  Serial.println("I2C scan: responding addresses (does not identify sensor types)");
  uint8_t count = 0;
  for (uint8_t address = 1; address < 127; address++) {
    if (i2cPresent(address)) {
      Serial.print("  0x");
      if (address < 16) Serial.print('0');
      Serial.println(address, HEX);
      count++;
    }
  }
  Serial.print("Addresses found: "); Serial.println(count);
}

// One callback per manually controlled actuator; no sensor callbacks.
void onPumpChange() {
  Serial.println("Cloud: pump changed");
  applyPump();
}
void onFanChange() {
  Serial.println("Cloud: fan changed");
  applyFan();
}
void onLightChange() {
  Serial.println("Cloud: light changed");
  applyLight();
}

#if ENABLE_SECOND_TH
void readSecondTH() {
  if (millis() - lastSecondTHMs < SECOND_TH_INTERVAL_MS) return;
  lastSecondTHMs = millis();
  if (secondReady && i2cPresent(CARRIER_BME_I2C_ADDRESS)) {
    // The Carrier library maintains its own measurement timing and cached values.
    temperature2 = carrier.Env.readTemperature();
    humidity2 = carrier.Env.readHumidity();
  } else {
    temperature2 = INVALID_MEASUREMENT;
    humidity2 = INVALID_MEASUREMENT;
  }
}
#endif

// Print the latest cached values every cycle; reading still follows its 3 s timer.
// Missing/disabled readings occupy the same single row as valid values.
void printSecondTH() {
#if ENABLE_SECOND_TH
  Serial.print("Onboard BME688: temperature = ");
  if (isfinite(temperature2) && temperature2 != INVALID_MEASUREMENT) Serial.print(temperature2);
  else Serial.print("--");
  Serial.print(" C, humidity = ");
  if (isfinite(humidity2) && humidity2 != INVALID_MEASUREMENT) Serial.print(humidity2);
  else Serial.print("--");
  Serial.println(" %");
#else
  Serial.println("Onboard BME688: disabled");
#endif
}



// ===================== Touch and display =====================
// onTouchDown generates one action per press, not one action per loop.
void readTouchButtons() {
  carrier.Buttons.update();
  if (carrier.Buttons.onTouchDown(FAN_TOUCH)) {
    Serial.println("Touch: fan toggle");
    fan = !fan;
    applyFan();
  }
  if (carrier.Buttons.onTouchDown(PUMP_TOUCH)) {
    Serial.println("Touch: pump toggle");
    pump = !pump;
    applyPump();
  }
  if (carrier.Buttons.onTouchDown(LIGHT_TOUCH)) {
    Serial.println("Touch: light toggle");
    light = !light;
    applyLight();
  }
  if (carrier.Buttons.onTouchDown(PAGE_UP_TOUCH)) changePage(-1);
  if (carrier.Buttons.onTouchDown(PAGE_DOWN_TOUCH)) changePage(1);
}

void announcePage() {
  Serial.print("Display page ");
  Serial.print(currentPage + 1);
  Serial.print('/');
  Serial.print(PAGE_COUNT);
  Serial.print(": ");
  Serial.println(PAGE_TITLES[currentPage]);
}

void changePage(int direction) {
  currentPage = (currentPage + PAGE_COUNT + direction) % PAGE_COUNT;
  displayTestActive = false;
  displayDirty = true;
  displayPageChanged = true;
  announcePage();
}

String measurementText(float value, uint8_t decimals) {
  if (!isfinite(value) || value == INVALID_MEASUREMENT) return "--";
  return String(value, decimals);
}

String rawText(int value) {
  return value == INVALID_RAW_READING ? "--" : String(value);
}

String stateText(bool on) {
  return on ? "ON" : "OFF";
}

String addressText(uint8_t address) {
  String hex = String(address, HEX);
  hex.toUpperCase();
  return "I2C: 0x" + hex;
}

String wifiStatusText(int status) {
  switch (status) {
    case WL_CONNECTED: return "connected";
    case WL_IDLE_STATUS: return "idle";
    case WL_NO_SSID_AVAIL: return "SSID not found";
    case WL_SCAN_COMPLETED: return "scan complete";
    case WL_CONNECT_FAILED: return "connect failed";
    case WL_CONNECTION_LOST: return "connection lost";
    case WL_DISCONNECTED: return "disconnected";
    case WL_NO_MODULE: return "no Wi-Fi module";
    default: return "status " + String(status);
  }
}

String cloudStatusText() {
  if (!CLOUD_ENABLED) return "disabled";
  return ArduinoCloud.connected() ? "connected" : "offline / connecting";
}

// Draw only changed text rows; no large framebuffer and no repeated full clear.
// Seven rows of 12 x 16 pixel characters fit inside the round display.
void displayLine(String text) {
  if (displayRow >= DISPLAY_ROWS) return;
  text = text.substring(0, DISPLAY_COLUMNS);
  if (text != previousLines[displayRow]) {
    const int y = DISPLAY_Y + displayRow * DISPLAY_LINE_HEIGHT;
    carrier.display.fillRect(DISPLAY_X, y, DISPLAY_COLUMNS * DISPLAY_CHAR_WIDTH,
                             DISPLAY_LINE_HEIGHT, DISPLAY_BACKGROUND);
    carrier.display.setCursor(DISPLAY_X, y);
    carrier.display.print(text);
    text.toCharArray(previousLines[displayRow], DISPLAY_COLUMNS + 1);
  }
  displayRow++;
}

// Full IDs and SSIDs are split across rows rather than truncated.
void displayWrapped(String text) {
  if (!text.length()) text = "(not available)";
  for (unsigned int offset = 0; offset < text.length(); offset += DISPLAY_COLUMNS) {
    displayLine(text.substring(offset, offset + DISPLAY_COLUMNS));
  }
}

// Overview contains only Cloud variable values. Units and full names are on
// the detail pages; actuator values are requested states (0 = off, 1 = on).
void drawOverview() {
  displayLine("T:" + measurementText(temperature, 0) + " H:" + measurementText(humidity, 0));
#if ENABLE_SECOND_TH
  displayLine("T2:" + measurementText(temperature2, 0) + " H2:" + measurementText(humidity2, 0));
#else
  displayLine("");
#endif
  displayLine("Pr:" + measurementText(pressure, 0));
  displayLine("G:" + (gasResistance == INVALID_MEASUREMENT || !isfinite(gasResistance) ? String("--") : measurementText(gasResistance / 1000.0f, 0) + "k"));
  displayLine("C:" + rawText(eCO2) + " V:" + rawText(tvoc));
  displayLine("S:" + rawText(soilRaw) + " L:" + rawText(lightLevel));
  displayLine("F:" + String(fan ? 1 : 0) + " P:" + String(pump ? 1 : 0) + " R:" + String(light ? 1 : 0));
}

void drawBmePage() {
  displayLine(addressText(BME_I2C_ADDRESS));
  displayLine("Cloud: float RO");
  displayLine("temperature");
  displayLine(measurementText(temperature, 2) + " C");
  displayLine("humidity");
  displayLine(measurementText(humidity, 2) + " % RH");
  displayLine("Pads:0x76/0x77");
}

void drawBmeGasPage() {
  displayLine(addressText(BME_I2C_ADDRESS));
  displayLine("Cloud: float RO");
  displayLine("pressure");
  displayLine(measurementText(pressure, 2) + " hPa");
  displayLine("gasResistance");
  displayLine(measurementText(gasResistance, 0) + " Ohm");
  displayLine("Gas is not CO2");
}

void drawSecondBmePage() {
  displayLine(addressText(CARRIER_BME_I2C_ADDRESS));
#if ENABLE_SECOND_TH
  displayLine("Cloud: float RO");
  displayLine("temperature2");
  displayLine(measurementText(temperature2, 2) + " C");
  displayLine("humidity2");
  displayLine(measurementText(humidity2, 2) + " % RH");
  displayLine(secondReady ? "Sensor: ready" : "Sensor: missing");
#else
  displayLine("Sensor disabled");
  displayLine("ENABLE_SECOND_TH");
  displayLine("Set to 1, then");
  displayLine("add Cloud floats");
  displayLine("temperature2");
  displayLine("humidity2");
#endif
}

void drawGasPage() {
  displayLine(addressText(SGP30_I2C_ADDRESS));
  displayLine("Cloud: int RO");
  displayLine("eCO2 [ppm]");
  displayLine(rawText(eCO2));
  displayLine("tvoc [ppb]");
  displayLine(rawText(tvoc));
  displayLine("eCO2: estimate");
}

void drawSoilPage() {
  displayLine("Pin: A" + String(SOIL_PIN - A0));
  displayLine("I2C: none");
  displayLine("Cloud: int RO");
  displayLine("soilRaw");
  displayLine(rawText(soilRaw));
  displayLine("ADC: 0-" + String((1UL << SOIL_ADC_BITS) - 1));
  displayLine("Not a percentage");
}

void drawLightPage() {
  displayLine(addressText(LIGHT_I2C_ADDRESS));
  displayLine("Cloud: int RO");
  displayLine("lightLevel");
  displayLine(rawText(lightLevel));
  displayLine("Raw clear count");
  displayLine("Not lux");
}

void drawRgbPage() {
  displayLine(addressText(LIGHT_I2C_ADDRESS));
  displayLine("Red: " + rawText(lightRed));
  displayLine("Green: " + rawText(lightGreen));
  displayLine("Blue: " + rawText(lightBlue));
  displayLine("Raw counts");
  displayLine("Local / Serial");
  displayLine("No Cloud vars");
}

void drawCloudPage() {
  displayLine("Cloud:");
  displayWrapped(cloudStatusText());
  displayLine("Wi-Fi:");
  displayWrapped(wifiStatusText(lastWifiStatus));
  displayLine("Vars: " + String(ENABLE_SECOND_TH ? 13 : 11));
}

void drawWifiPage() {
  displayLine("SSID:");
  displayWrapped(String(SECRET_SSID));
  displayLine("IP:");
  displayWrapped(lastWifiStatus == WL_CONNECTED ? WiFi.localIP().toString() : "--");
  displayLine(lastWifiStatus == WL_CONNECTED ? "RSSI:" + String(WiFi.RSSI()) + " dBm" : "RSSI: --");
}

void drawThingIdPage() {
  displayWrapped(observedThingId);
  displayLine("");
  displayLine("Runtime Cloud ID");
  displayLine("Shown when");
  displayLine("connected");
}

void drawDeviceIdPage() {
  displayWrapped(observedDeviceId);
  displayLine("");
  displayLine("Secure element");
  displayLine("Different from");
  displayLine("Thing ID");
}

void updateDisplay() {
  if (displayTestActive && updateDisplayTest()) return;
  const unsigned long now = millis();
  if (!displayDirty && now - lastDisplayMs < DISPLAY_REFRESH_MS) return;
  lastDisplayMs = now;
  displayDirty = false;
  const int wifiStatus = CLOUD_ENABLED ? WiFi.status() : WL_DISCONNECTED;
  if (wifiStatus != lastWifiStatus) {
    lastWifiStatus = wifiStatus;
    Serial.print("Wi-Fi: ");
    Serial.println(wifiStatusText(lastWifiStatus));
    Serial.print("Configured SSID: "); Serial.println(SECRET_SSID);
    if (lastWifiStatus == WL_CONNECTED) {
      Serial.print("Wi-Fi IP: "); Serial.println(WiFi.localIP());
      Serial.print("Wi-Fi RSSI: "); Serial.println(WiFi.RSSI());
    }
  }
  String thingId = CLOUD_ENABLED && ArduinoCloud.connected() ? ArduinoCloud.getThingId() : String("");
  String deviceId = CLOUD_ENABLED ? ArduinoCloud.getDeviceId() : String("");
  // The library uses this placeholder before an ID has been obtained.
  if (thingId == "xxxxxxxx-xxxx-xxxx-xxxx-xxxxxxxxxxxx") thingId = "";
  if (deviceId == "xxxxxxxx-xxxx-xxxx-xxxx-xxxxxxxxxxxx") deviceId = "";
  if (thingId != observedThingId || deviceId != observedDeviceId) {
    observedThingId = thingId;
    observedDeviceId = deviceId;
    Serial.print("Cloud Thing ID: "); Serial.println(thingId.length() ? thingId : "(not available)");
    Serial.print("Cloud Device ID: "); Serial.println(deviceId.length() ? deviceId : "(not available)");
  }
  if (displayPageChanged) {
    carrier.display.fillScreen(DISPLAY_BACKGROUND);
    memset(previousLines, 0, sizeof(previousLines));
    carrier.display.setTextSize(DISPLAY_TEXT_SIZE);
    carrier.display.setTextColor(DISPLAY_ACCENT);
    String title = PAGE_TITLES[currentPage];
    carrier.display.setCursor((DISPLAY_WIDTH - title.length() * DISPLAY_CHAR_WIDTH) / 2, 24);
    carrier.display.print(title);
    String footer = "03< " + String(currentPage + 1) + "/" + String(PAGE_COUNT) + " >04";
    carrier.display.setCursor((DISPLAY_WIDTH - footer.length() * DISPLAY_CHAR_WIDTH) / 2, 192);
    carrier.display.print(footer);
    displayPageChanged = false;
  }
  carrier.display.setTextSize(DISPLAY_TEXT_SIZE);
  carrier.display.setTextColor(DISPLAY_FOREGROUND);
  displayRow = 0;
  switch (currentPage) {
    case 0: drawOverview(); break;
    case 1: drawBmePage(); break;
    case 2: drawBmeGasPage(); break;
    case 3: drawSecondBmePage(); break;
    case 4: drawGasPage(); break;
    case 5: drawSoilPage(); break;
    case 6: drawLightPage(); break;
    case 7: drawRgbPage(); break;
    case 8: drawCloudPage(); break;
    case 9: drawWifiPage(); break;
    case 10: drawThingIdPage(); break;
    case 11: drawDeviceIdPage(); break;
  }
  while (displayRow < DISPLAY_ROWS) displayLine("");
}


// These diagnostics report commands sent, not a successful LCD response.
void initializeDisplay() {
  const bool isRev2 = carrier.getBoardRevision() == BOARD_REVISION_2;
  Serial.print("Display: detected Carrier revision ");
  Serial.println(isRev2 ? "2" : "1");
  if (!isRev2) {
    Serial.println("Display: WARNING: this sample's relay wiring requires Carrier Rev2.");
  }
  Serial.print("Display: CS=D");
  Serial.print(isRev2 ? DISPLAY_CS_PIN : mkr_iot_carrier_rev1::TFT_CS);
  Serial.print(", DC=D");
  Serial.println(isRev2 ? DISPLAY_DC_PIN : mkr_iot_carrier_rev1::TFT_DC);

  // Restore SPI and LCD configuration after all other begin() calls.
  // Keep the revision-specific display object created by carrier.begin().
  carrier.display.init(DISPLAY_WIDTH, DISPLAY_HEIGHT);
  carrier.display.setSPISpeed(DISPLAY_SPI_HZ);
  carrier.display.enableDisplay(true);
  carrier.display.setRotation(DISPLAY_ROTATION);
  carrier.display.setTextWrap(false);
  if (isRev2) {
    digitalWrite(DISPLAY_BACKLIGHT_PIN, DISPLAY_BACKLIGHT_ON_LEVEL);
    pinMode(DISPLAY_BACKLIGHT_PIN, OUTPUT);
    Serial.print("Display: backlight D");
    Serial.print(DISPLAY_BACKLIGHT_PIN);
    Serial.print(" reads ");
    Serial.println(digitalRead(DISPLAY_BACKLIGHT_PIN) == HIGH ? "HIGH" : "LOW");
  }
  displayDirty = true;
  displayPageChanged = true;
  Serial.println("Display: initialization commands sent; visual confirmation required.");
}

void startDisplayTest() {
  displayTestActive = true;
  displayTestStartMs = millis();
  displayTestPreviousColor = -1;
  Serial.println("Display test: RED -> GREEN -> BLUE -> WHITE, then normal pages.");
}

bool updateDisplayTest() {
  const unsigned long colorIndex = (millis() - displayTestStartMs) / DISPLAY_TEST_COLOR_MS;
  if (colorIndex >= DISPLAY_TEST_COLOR_COUNT) {
    displayTestActive = false;
    displayDirty = true;
    displayPageChanged = true;
    Serial.println("Display test: complete; drawing the selected page.");
    return false;
  }
  if (displayTestPreviousColor != (int)colorIndex) {
    const uint16_t colors[DISPLAY_TEST_COLOR_COUNT] = {
      ST77XX_RED, ST77XX_GREEN, ST77XX_BLUE, ST77XX_WHITE
    };
    const char* const labels[DISPLAY_TEST_COLOR_COUNT] = {
      "RED", "GREEN", "BLUE", "WHITE"
    };
    displayTestPreviousColor = colorIndex;
    carrier.display.fillScreen(colors[colorIndex]);
    carrier.display.setTextSize(2);
    carrier.display.setTextColor(colorIndex == 2 ? ST77XX_WHITE : ST77XX_BLACK);
    carrier.display.setCursor(48, 96);
    carrier.display.print("DISPLAY TEST");
    carrier.display.setCursor(84, 126);
    carrier.display.print(labels[colorIndex]);
    Serial.print("Display test: drawing ");
    Serial.println(labels[colorIndex]);
  }
  // Sensor readings, Cloud updates and touch processing continue in loop().
  return true;
}
