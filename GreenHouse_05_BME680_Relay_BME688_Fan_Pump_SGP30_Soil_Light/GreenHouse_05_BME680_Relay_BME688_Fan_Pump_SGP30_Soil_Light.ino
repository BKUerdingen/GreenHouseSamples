/*
  GreenHouse_05_BME680_Relay_BME688_Fan_Pump_SGP30_Soil_Light - Read sensors and control actuators manually.
  Arduino MKR WiFi 1010 + MKR IoT Carrier Rev2 / Greenhouse Kit.
  No thresholds or automatic watering, ventilation, or lighting.
  Instructions, wiring, and Cloud setup: README.md

  Author (concept and project direction): David Voss.
  Code and documentation generated by OpenAI Codex using GPT-6 Astra,
  following David Voss's requirements and instructions.
  An outcome of a 2026 Erasmus+ project between Berufskolleg Uerdingen,
  Krefeld, Germany, and Colegiul Tehnic "Costin D. Nenițescu" Pitești, Romania.
*/
#ifndef ENABLE_SECOND_TH
#define ENABLE_SECOND_TH 1  // Optional onboard BME688: change 0 to 1.
#endif
#include <Wire.h>
#include <Arduino_MKRIoTCarrier.h>
// Grove I2C Motor Driver v1.3 - required library version: 1.0.1
#include <Grove_I2C_Motor_Driver.h>
#include <Zanshin_BME680.h>
#include <Adafruit_SGP30.h>

// ===================== Hardware test settings =====================
const bool CLOUD_ENABLED = true;       // Set to true only after configuring the Thing
const unsigned long SERIAL_BAUD = 9600;
const unsigned long SERIAL_WAIT_MS = 3000;
const unsigned long MEASUREMENT_INTERVAL_MS = 1000; // SGP30 requires approximately 1 Hz!
const uint32_t I2C_CLOCK_HZ = 100000;
const unsigned long LIGHT_READ_TIMEOUT_MS = 100; // Allow APDS9960 integration to finish

const uint8_t SOIL_PIN = A0;
const uint8_t LIGHT_RELAY_PIN = 2;       // Carrier Rev2: relay 2
const uint8_t RELAY_ON_LEVEL = HIGH;    // Swap levels if required by a different relay
const uint8_t RELAY_OFF_LEVEL = LOW;
const uint8_t SOIL_ADC_BITS = 10;        // Raw values 0 ... 1023; not a percentage

const uint8_t MOTOR_I2C_ADDRESS = 0x0F;  // Must match the address switch settings
const uint8_t BME_I2C_ADDRESS = 0x77;    // External: 0x76 OR 0x77; check the solder pads!
const uint8_t SGP30_I2C_ADDRESS = 0x58;  // Fixed; the library uses this address
const uint8_t LIGHT_I2C_ADDRESS = 0x39;  // Onboard APDS9960, fixed
const uint8_t CARRIER_BME_I2C_ADDRESS = 0x76; // Rev2: already used by the onboard sensor!
// Wire uses the fixed MKR pins SDA/D11 and SCL/D12 (I2C Grove connector).
// The two fixed sensor addresses are also used to check device presence.

const uint8_t PUMP_MOTOR_CHANNEL = MOTOR1;
const uint8_t FAN_MOTOR_CHANNEL = MOTOR2;
const int PUMP_ON_SPEED = 100;           // Library 1.0.1: -100 ... 100 percent PWM duty cycle
const int FAN_ON_SPEED = 100;
const int MOTOR_OFF_SPEED = 0;
static_assert(PUMP_ON_SPEED >= -100 && PUMP_ON_SPEED <= 100, "Pump speed must be -100 ... 100.");
static_assert(FAN_ON_SPEED >= -100 && FAN_ON_SPEED <= 100, "Fan speed must be -100 ... 100.");

const bool INITIAL_PUMP_ON = false;
const bool INITIAL_FAN_ON = false;
const bool INITIAL_LIGHT_ON = false;
const float INVALID_MEASUREMENT = -999.0f; // No BME reading yet, or BME unavailable
const bool CARRIER_HAS_CASE = true;
const unsigned long SECOND_TH_INTERVAL_MS = 3000;
const int INVALID_RAW_READING = -1;
const uint8_t BME_OVERSAMPLING = Oversample16;
const uint8_t BME_FILTER = IIR4;
const uint16_t BME_HEATER_C = 320;
const uint16_t BME_HEATER_MS = 150;

#include "thingProperties.h"

MKRIoTCarrier carrier;
BME680_Class bme;
Adafruit_SGP30 sgp;
bool motorReady = false;
bool bmeReady = false;
bool sgpReady = false;
bool lightReady = false;
bool cloudWasConnected = false;
unsigned long lastMeasurementMs = 0;

#if ENABLE_SECOND_TH
bool secondReady = false;
unsigned long lastSecondTHMs = 0;
#endif


void setup() {
  // Turn the relay off first; apply the initial state after carrier.begin().
  digitalWrite(LIGHT_RELAY_PIN, RELAY_OFF_LEVEL);
  pinMode(LIGHT_RELAY_PIN, OUTPUT);
  Serial.begin(SERIAL_BAUD);
  const unsigned long serialStart = millis();
  while (!Serial && millis() - serialStart < SERIAL_WAIT_MS) { }
  Serial.println("\nGreenHouse_05_BME680_Relay_BME688_Fan_Pump_SGP30_Soil_Light: manual hardware test");

  Wire.begin();
  Wire.setClock(I2C_CLOCK_HZ);
  pinMode(SOIL_PIN, INPUT);
  analogReadResolution(SOIL_ADC_BITS);

  // Initialize actuators independently of the sensors and Cloud.
  motorReady = i2cPresent(MOTOR_I2C_ADDRESS);
  if (motorReady) {
    Motor.begin(MOTOR_I2C_ADDRESS);
    Serial.begin(SERIAL_BAUD); // Motor.begin() sets the baud rate to 9600.
    Motor.speed(PUMP_MOTOR_CHANNEL, MOTOR_OFF_SPEED);
    Motor.speed(FAN_MOTOR_CHANNEL, MOTOR_OFF_SPEED);
  }
  printDevice("Motor driver", MOTOR_I2C_ADDRESS, motorReady);

  if (CARRIER_HAS_CASE) carrier.withCase();
  else carrier.noCase();
  Serial.println(carrier.begin() ? "Carrier: OK" : "Carrier: at least one module is unavailable");
  // Test the light sensor even if another Carrier module fails.
  lightReady = i2cPresent(LIGHT_I2C_ADDRESS) && carrier.Light.begin();
  printDevice("Light sensor", LIGHT_I2C_ADDRESS, lightReady);

#if ENABLE_SECOND_TH
  temperature2 = INVALID_MEASUREMENT;
  humidity2 = INVALID_MEASUREMENT;
  secondReady = carrier.getBoardRevision() == BOARD_REVISION_2 &&
                i2cPresent(CARRIER_BME_I2C_ADDRESS) && carrier.Env.begin();
  Serial.println(secondReady ? "Second T/H sensor: ready" : "Second T/H sensor: unavailable");
#endif


  pump = INITIAL_PUMP_ON;
  fan = INITIAL_FAN_ON;
  light = INITIAL_LIGHT_ON;
  temperature = INVALID_MEASUREMENT;
  humidity = INVALID_MEASUREMENT;
  lightLevel = INVALID_RAW_READING;
  soilRaw = INVALID_RAW_READING;
  eCO2 = INVALID_RAW_READING;
  tvoc = INVALID_RAW_READING;
  pressure = INVALID_MEASUREMENT;
  gasResistance = INVALID_MEASUREMENT;
  Serial.println("Initial states:");
  applyPump();
  applyFan();
  applyLight();

  // Rev2 already uses 0x76 internally. Do not attach a second driver to it.
  if (carrier.getBoardRevision() == BOARD_REVISION_2 &&
      BME_I2C_ADDRESS == CARRIER_BME_I2C_ADDRESS) {
    Serial.println("BME: address conflict! Set the external sensor solder pads to 0x77 and update the constant.");
  } else {
    bmeReady = bme.begin(I2C_CLOCK_HZ, BME_I2C_ADDRESS);
  }
  printDevice("External BME680", BME_I2C_ADDRESS, bmeReady);
  if (bmeReady) {
    bme.setOversampling(TemperatureSensor, BME_OVERSAMPLING);
    bme.setOversampling(HumiditySensor, BME_OVERSAMPLING);
    bme.setOversampling(PressureSensor, BME_OVERSAMPLING);
    bme.setIIRFilter(BME_FILTER);
    bme.setGas(BME_HEATER_C, BME_HEATER_MS);
    bme.triggerMeasurement();
  }

  sgpReady = i2cPresent(SGP30_I2C_ADDRESS) && sgp.begin(); // Includes IAQinit()
  printDevice("SGP30", SGP30_I2C_ADDRESS, sgpReady);
  if (sgpReady) Serial.println("SGP30: the first ~15 s return warm-up values (400 ppm / 0 ppb).");
  Wire.setClock(I2C_CLOCK_HZ); // Some begin() functions reconfigure Wire.
  scanI2c();
  printHelp();

  if (CLOUD_ENABLED) {
    initProperties();
    ArduinoCloud.begin(ArduinoIoTPreferredConnection);
    setDebugMessageLevel(2);
    ArduinoCloud.printDebugInfo();
    Serial.println("Cloud: connecting; hardware testing continues.");
  } else {
    Serial.println("Cloud: disabled. Use the Serial Monitor to control the hardware.");
  }
  lastMeasurementMs = millis();
}

void loop() {
  if (CLOUD_ENABLED) {
    ArduinoCloud.update();
    const bool connected = ArduinoCloud.connected();
    if (connected != cloudWasConnected) {
      Serial.println(connected ? "Cloud: connected" : "Cloud: disconnected");
      cloudWasConnected = connected;
    }
  }
  readSerialCommand();

  // Measurement timing only; no automatic actuator decisions.
  const unsigned long now = millis();
  if (now - lastMeasurementMs >= MEASUREMENT_INTERVAL_MS) {
    lastMeasurementMs = now;
    readSensors();
    printActuators();
  }
}

void readSensors() {
  Serial.println("--- Sensors ---");
#if ENABLE_SECOND_TH
  readSecondTH();
#endif
  printSecondTH(); // Always reserve one row, including between sensor updates.
  // Read the SGP30 regularly, once per second.
  if (sgpReady && sgp.IAQmeasure()) {
    eCO2 = sgp.eCO2;
    tvoc = sgp.TVOC;
    Serial.print("SGP30: eCO2 = "); Serial.print(sgp.eCO2);
    Serial.print(" ppm, TVOC = "); Serial.print(sgp.TVOC); Serial.println(" ppb");
  } else {
    eCO2 = INVALID_RAW_READING;
    tvoc = INVALID_RAW_READING;
    Serial.println("SGP30: eCO2 = -- ppm, TVOC = -- ppb");
  }

  if (bmeReady && i2cPresent(BME_I2C_ADDRESS) && !bme.measuring()) {
    int32_t rawTemperature, rawHumidity, pressurePa, gasOhm;
    // false: do not wait for a measurement. This call starts the next one.
    const uint8_t gasStatus = bme.getSensorData(rawTemperature, rawHumidity,
                                               pressurePa, gasOhm, false);
    temperature = rawTemperature / 100.0f;
    humidity = rawHumidity / 1000.0f;
    pressure = pressurePa / 100.0f;
    gasResistance = gasOhm;
    Serial.print("BME680: temperature = "); Serial.print(temperature);
    Serial.print(" C, humidity = "); Serial.print(humidity);
    Serial.println(" %");
    Serial.print("BME680: pressure = "); Serial.print(pressure);
    Serial.print(" hPa, gas = "); Serial.print(gasOhm); Serial.println(" Ohm");
    Serial.print("BME680: gas status = 0x"); Serial.println(gasStatus, HEX);
  } else {
    temperature = INVALID_MEASUREMENT;
    humidity = INVALID_MEASUREMENT;
    pressure = INVALID_MEASUREMENT;
    gasResistance = INVALID_MEASUREMENT;
    Serial.println("BME680: temperature = -- C, humidity = -- %");
    Serial.println("BME680: pressure = -- hPa, gas = -- Ohm");
    Serial.println("BME680: gas status = -- (no reading)");
  }

  soilRaw = analogRead(SOIL_PIN);
  Serial.print("Soil moisture: raw ADC value = "); Serial.println(soilRaw);
  readLightSensor();
}

// APDS9960 colorAvailable() starts a conversion; readColor() stops it again.
// Wait briefly for a fresh reading instead of treating "still measuring" as failure.
void readLightSensor() {
  int red, green, blue, clear;
  bool readOk = false;
  const char* error = "sensor unavailable at 0x39";
  if (lightReady && i2cPresent(LIGHT_I2C_ADDRESS)) {
    error = "measurement timeout";
    const unsigned long startedMs = millis();
    do {
      if (carrier.Light.colorAvailable()) {
        readOk = carrier.Light.readColor(red, green, blue, clear);
        error = "I2C read failed";
        break;
      }
      delay(1);
    } while (millis() - startedMs < LIGHT_READ_TIMEOUT_MS);
  }
  if (readOk) {
    lightLevel = clear;
    Serial.print("Light: R = "); Serial.print(red);
    Serial.print(", G = "); Serial.print(green);
    Serial.print(", B = "); Serial.print(blue);
    Serial.print(", clear = "); Serial.println(clear);
  } else {
    lightLevel = INVALID_RAW_READING;
    Serial.print("Light: R/G/B/clear = --; "); Serial.println(error);
  }
}

// These three functions demonstrate the actual actuator commands.
void applyPump() {
  if (motorReady && i2cPresent(MOTOR_I2C_ADDRESS)) {
    Motor.speed(PUMP_MOTOR_CHANNEL, pump ? PUMP_ON_SPEED : MOTOR_OFF_SPEED);
    Serial.print("Pump: command "); Serial.println(pump ? "ON" : "OFF");
  } else {
    Serial.println("Pump: command not sent, motor driver unavailable");
  }
}

void applyFan() {
  if (motorReady && i2cPresent(MOTOR_I2C_ADDRESS)) {
    Motor.speed(FAN_MOTOR_CHANNEL, fan ? FAN_ON_SPEED : MOTOR_OFF_SPEED);
    Serial.print("Fan: command "); Serial.println(fan ? "ON" : "OFF");
  } else {
    Serial.println("Fan: command not sent, motor driver unavailable");
  }
}

void applyLight() {
  digitalWrite(LIGHT_RELAY_PIN, light ? RELAY_ON_LEVEL : RELAY_OFF_LEVEL);
  Serial.print("Light relay: command "); Serial.println(light ? "ON" : "OFF");
}

void printActuators() {
  // Requested states: the actuators provide no feedback about actual operation.
  Serial.print("Actuators (requested): pump = "); Serial.print(pump ? "ON" : "OFF");
  Serial.print(", fan = "); Serial.print(fan ? "ON" : "OFF");
  Serial.print(", light = "); Serial.println(light ? "ON" : "OFF");
}

void printHelp() {
  Serial.println("Commands: p/P = pump on/off, f/F = fan on/off, l/L = light on/off");
  Serial.println("         0 = all off, s = requested states, i = I2C scan, ? = help");
}

void readSerialCommand() {
  if (!Serial.available()) return;
  const char command = Serial.read();
  if (command == '\r' || command == '\n' || command == ' ') return;
  Serial.print("Serial command: "); Serial.println(command);
  switch (command) {
    case 'p': pump = true;  applyPump();  break;
    case 'P': pump = false; applyPump();  break;
    case 'f': fan = true;   applyFan();   break;
    case 'F': fan = false;  applyFan();   break;
    case 'l': light = true;  applyLight(); break;
    case 'L': light = false; applyLight(); break;
    case '0':
      pump = false; fan = false; light = false;
      applyPump(); applyFan(); applyLight();
      break;
    case 's': printActuators(); break;
    case 'i': scanI2c(); break;
    case '?': printHelp(); break;
    default: Serial.println("Unknown command. Enter ? for help."); break;
  }
}

bool i2cPresent(uint8_t address) {
  Wire.beginTransmission(address);
  return Wire.endTransmission() == 0;
}

void printDevice(const char* name, uint8_t address, bool ready) {
  Serial.print(name); Serial.print(" @ 0x"); Serial.print(address, HEX);
  Serial.println(ready ? ": OK" : ": not ready (check address/wiring)");
}

void scanI2c() {
  Serial.println("I2C scan: responding addresses (does not identify sensor types)");
  uint8_t count = 0;
  for (uint8_t address = 1; address < 127; address++) {
    if (i2cPresent(address)) {
      Serial.print("  0x");
      if (address < 16) Serial.print('0');
      Serial.println(address, HEX);
      count++;
    }
  }
  Serial.print("Addresses found: "); Serial.println(count);
}

// One callback per manually controlled actuator; no sensor callbacks.
void onPumpChange() {
  Serial.println("Cloud: pump changed");
  applyPump();
}
void onFanChange() {
  Serial.println("Cloud: fan changed");
  applyFan();
}
void onLightChange() {
  Serial.println("Cloud: light changed");
  applyLight();
}

#if ENABLE_SECOND_TH
void readSecondTH() {
  if (millis() - lastSecondTHMs < SECOND_TH_INTERVAL_MS) return;
  lastSecondTHMs = millis();
  if (secondReady && i2cPresent(CARRIER_BME_I2C_ADDRESS)) {
    // The Carrier library maintains its own measurement timing and cached values.
    temperature2 = carrier.Env.readTemperature();
    humidity2 = carrier.Env.readHumidity();
  } else {
    temperature2 = INVALID_MEASUREMENT;
    humidity2 = INVALID_MEASUREMENT;
  }
}
#endif

// Print the latest cached values every cycle; reading still follows its 3 s timer.
// Missing/disabled readings occupy the same single row as valid values.
void printSecondTH() {
#if ENABLE_SECOND_TH
  Serial.print("Onboard BME688: temperature = ");
  if (isfinite(temperature2) && temperature2 != INVALID_MEASUREMENT) Serial.print(temperature2);
  else Serial.print("--");
  Serial.print(" C, humidity = ");
  if (isfinite(humidity2) && humidity2 != INVALID_MEASUREMENT) Serial.print(humidity2);
  else Serial.print("--");
  Serial.println(" %");
#else
  Serial.println("Onboard BME688: disabled");
#endif
}
